/* 

Arduino and Processing Serial Link
PA - Processing Side
Version 0.1

Provides a serial link, sending and receiving, between a computer running Processing and an Arduino.

Behavior
Listens for byte 255 from an Arduino. 
After hearing 255, sends randomly generated bytes between 0 and 100 
at a rate specified by frameRate(N). Prints sent bytes and any received bytes.

*/


import processing.serial.*;
Serial serial; // initialize the serial port 
boolean serialStatus = false; // "true" means the connection is active


void setup(){
  
 // open the serial port
 serial = new Serial(this, "/dev/tty.usbserial-A600enQ2", 115200);
 serial.clear();

 frameRate(10); // max number of times draw() is executed per second

 println("setup() complete");
} //setup()


void draw(){
  
 if (serialStatus){
    // send a random byte between 0 and 100
    int sentNum = int(random(100));
    serial.write(byte(sentNum));
    print("Sent ");
    println(sentNum);
  }

} //draw()


// Called after each execution of draw()
// if there is serial data availble
void serialEvent(Serial serial){
  if (serialStatus){
    print("Received ");
    println(serial.read());
  }
  
  else{
    print("serialStatus ");
    println(serialStatus);
    if(serial.available() > 0){
      int tempByte = serial.read(); // read a byte
      if (tempByte == 255){ 
        serial.write(byte(0)); //send something so that the Arduino stops broadcasting
        serialStatus = true;
        print("serialStatus ");
        println(serialStatus);
        serial.clear();
      }
    }
  }
 
} //serialEvent()
